## config/west.yml
```yaml
manifest:
  remotes:
    - name: zmkfirmware
      url-base: https://github.com/zmkfirmware
      # Additional modules containing boards/shields/custom code can be listed here as well.
      # See:
      # - https://zmk.dev/docs/features/modules
      # - https://docs.zephyrproject.org/3.5.0/develop/west/manifest.html#projects
  projects:
    - name: eyelash_corne
      url: https://github.com/a741725193/zmk-new_corne
      # Pinned to last HWMv1 revision (a7d93082, 2026-03-05). The vendor's
      # "Dev1 (#63)" (2026-06-05) migrated the board to HWMv2 shield layout,
      # which the pinned pre-Zephyr-4.1 ZMK can't resolve ("Invalid BOARD").
      # Unpin together with the zmk revision below when moving to HWMv2.
      revision: a7d93082b24f5b20e710a5db9b0e3141ade229b3
    - name: zmk
      remote: zmkfirmware
      # Pinned to last commit before ZMK moved to Zephyr v4.1 (c06fa48 on
      # 2025-12-10, which broke HWMv1 boards and updated module manifests).
      # The eyelash_corne board uses HWMv1 (boards/arm/eyelash_corne/).
      # Unpin when the vendor board migrates to HWMv2.
      revision: abb64ba316c29caddc49727ca2cac2f0ed5970c7
      import: app/west.yml
  self:
    path: config
```
